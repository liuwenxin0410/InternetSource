
/********************金逸晨**************************
*****************1.3   4PIN IIC OLED FOR STM8S*************
*****STM8S003F3驱动**************************
***** PC3----3  SCK   ,  PC4----4  SDA   ,  
***** BY:GU 
*********1.3寸旋转90度显示，结合取模方式，及翻转命令完成旋转显示
********************************************************/
#include "IOSTM8S003F3.h"

#define set_0   0x01
#define set_1   0x02
#define set_2   0x04
#define set_3   0x08    
#define set_4   0x10
#define set_5   0x20
#define set_6   0x40
#define set_7   0x80

#define clr_0   0xFE
#define clr_1   0xFD
#define clr_2   0xFB
#define clr_3   0xF7    
#define clr_4   0xEF
#define clr_5   0xDF
#define clr_6   0xBF
#define clr_7   0x7F


#define OLED_COLUMN_NUMBER 128
#define OLED_LINE_NUMBER 64
#define OLED_COLUMN_OFFSET 2
#define OLED_PAGE_NUMBER OLED_LINE_NUMBER/8

/**********IIC引脚分配，连接oled屏，更具实际情况修改*********/

#define IIC_SCK_0  PC_ODR&=clr_3        //PC3       
#define IIC_SCK_1  PC_ODR|=set_3       
#define IIC_SDA_0  PC_ODR&=clr_4        //PC4        
#define IIC_SDA_1  PC_ODR|=set_4
#define IIC_RST_0  PC_ODR&=clr_5        //PC5        
#define IIC_RST_1  PC_ODR|=set_5
#define READ_SDA   ( PC_IDR & set_4 )    
const unsigned char  *point;
unsigned char ACK=0;
const unsigned char  OLED_init_cmd[25]=         //SH1106
{
        0xAE,//关闭显示
	
       0xD5,//设置时钟分频因子,震荡频率
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       0x02,//[1:0],00，列地址模式;01，行地址模式;10,页地址模式;默认10;
	   
/************显示翻转命令**********************************************/
       0xA1,//段重定义设置,bit0:0,0->0;1,0->127;  A1
	
       0xC0,//设置COM扫描方向;bit3:0,普通模式;1,重定义模式 COM[N-1]->COM0;N:驱动路数 (C0 翻转显示) C8
/********************************************************************************************************/
       0xDA,//设置COM硬件引脚配置
       0x12,//[5:4]配置  
	   
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       0xAF,//开启显示     
};
const unsigned char picture_rev_90[]=   //旋转90度显示，行列式，低位在前，阴码
{  
    0x00,0x00,0x00,0x00,0x00,0x00,0x00,0x00,0x00,0x00,0x00,0x00,0x00,0x80,0xC0,0xE0,
    0x60,0x70,0x30,0x30,0x38,0x18,0x18,0x18,0x18,0xD8,0xF8,0xF0,0xF0,0xF0,0xE0,0xE0,
    0xC0,0xC0,0xC0,0x00,0x00,0x00,0x00,0x00,0x00,0x00,0x00,0x00,0x00,0x00,0x00,0x00,
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    0x00,0x00,0x00,0x00,0x00,0x00,0x00,0x00,0x00,0x00,0x00,0x00,0x00,0x00,0x00,0x00
};
const unsigned char  picture_tab[]={
/*------------------------------------------------------------------------------
;  列行式，低位在前，阴码
;  宽×高（像素）: 128×64
------------------------------------------------------------------------------*/
    0x00,0x00,0x00,0x00,0x00,0x00,0x00,0x00,0x00,0x00,0x00,0x00,0x00,0x00,0x00,0x00,
    0x00,0x00,0x00,0x00,0x00,0x00,0x00,0x00,0x00,0x00,0x00,0x00,0x00,0x00,0x00,0x00,
    0x00,0x00,0x00,0x00,0x00,0x00,0x00,0x00,0x00,0x00,0x00,0x00,0x00,0x00,0x00,0x00,
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    0x00,0x00,0x00,0x00,0x00,0x00,0x00,0x00,0x00,0x00,0x00,0x00,0x00,0x00,0x00,0x00,
};

/*******时钟初始化******************/
void CLK_init(void)
{
  
  CLK_CKDIVR|= 0x00;       /*设置时钟为内部16M高速时钟*/ 
}
void delay_us(unsigned int _us_time)
{       
  unsigned char x=0;
  for(;_us_time>0;_us_time--)
  {
    x++;
  }
}
void delay_ms(unsigned int _ms_time)
  {
    unsigned int i,j;
    for(i=0;i<_ms_time;i++)
    {
    for(j=0;j<900;j++)
      {;}
    }
  }

/**************************IIC模块发送函数************************************************

 *************************************************************************/
//写入  最后将SDA拉高，以等待从设备产生应答
void IIC_write(unsigned char date)
{
	unsigned char i, temp;
	temp = date;
			
	for(i=0; i<8; i++)
	{	IIC_SCK_0;
		
                if ((temp&0x80)==0)
                  IIC_SDA_0;
                else IIC_SDA_1;
		temp = temp << 1;
						  //最少250ns延时
		IIC_SCK_1;
		
	}
	IIC_SCK_0;
	
	IIC_SDA_1;
	
	IIC_SCK_1;
	
	if (READ_SDA==0)
		ACK = 1;
	else ACK =0;
	IIC_SCK_0;
	

}
//启动信号
//SCL在高电平期间，SDA由高电平向低电平的变化定义为启动信号
void IIC_start()
{
	IIC_SDA_1;
	
	IIC_SCK_1;
					   //所有操作结束释放SCL	
	IIC_SDA_0;
	
	IIC_SCK_0;
	
        IIC_write(0x78);
        
}

//停止信号
//SCL在高电平期间，SDA由低电平向高电平的变化定义为停止信号
void IIC_stop()
{
	IIC_SDA_0;
	
	IIC_SCK_1;
	
	IIC_SDA_1;
	
}

void OLED_send_cmd(unsigned char o_command)
  {
    
    IIC_start();
    IIC_write(0x00); 
    IIC_write(o_command);
    IIC_stop();
    
  }
void OLED_send_data(unsigned char o_data)
  { 
    IIC_start();
    IIC_write(0x40);
    IIC_write(o_data);
    IIC_stop();
   }
void Column_set(unsigned char column)
  {
    column+=OLED_COLUMN_OFFSET;
    OLED_send_cmd(0x10|(column>>4));    //设置列地址高位
    OLED_send_cmd(0x00|(column&0x0f));   //设置列地址低位  
    	 
  }
void Page_set(unsigned char page)
  {
    OLED_send_cmd(0xb0+page);
  }
void OLED_clear(void)
  {
    unsigned char page,column;
    for(page=0;page<OLED_PAGE_NUMBER;page++)             //page loop
      { 
          Page_set(page);
          Column_set(0);	  
          for(column=0;column<OLED_COLUMN_NUMBER;column++)	//column loop
            {
              OLED_send_data(0x00);
            }
      }
  }
void OLED_full(void)
  {
    unsigned char page,column;
    for(page=0;page<OLED_PAGE_NUMBER;page++)             //page loop
      { 
        Page_set(page);
        Column_set(0);	  
	for(column=0;column<OLED_COLUMN_NUMBER;column++)	//column loop
          {
            OLED_send_data(0xff);
          }
      }
  }
void OLED_init(void)
  {
    unsigned char i;
    for(i=0;i<25;i++)
      {
        OLED_send_cmd(OLED_init_cmd[i]);
      }
  }

void Picture_display(const unsigned char *ptr_pic)
  {
    unsigned char page,column;
    for(page=0;page<OLED_PAGE_NUMBER;page++)        //page loop
      { 
	Page_set(page);
	Column_set(0);	  
	for(column=0;column<OLED_COLUMN_NUMBER;column++)	//column loop
          {
            OLED_send_data(*ptr_pic++);
          }
      }
  }
void Picture_ReverseDisplay(const unsigned char *ptr_pic)
{
    unsigned char page,column,data;
    for(page=0;page<OLED_PAGE_NUMBER;page++)        //page loop
      { 
	Page_set(page);
	Column_set(0);	  
	for(column=0;column<OLED_COLUMN_NUMBER;column++)	//column loop
          {
            data=*ptr_pic++;
            data=~data;
            OLED_send_data(data);
          }
      }
  }
void IO_init(void)
{
  PC_DDR|=0xFF;                         //PC  06,07，03,04,07开漏输出模式
  PC_CR1|=0x00;
  PC_CR2|=0xFF;
  PC_ODR=0XFF;
}
void main()
{ 
  point= &picture_rev_90[0];
  IO_init();
  OLED_init();
  OLED_full();
  delay_ms(1000);
  OLED_clear();
  while(1)
  {
    Picture_display(point);
    delay_ms(1000);
    
    Picture_ReverseDisplay(point);
    delay_ms(1000);
    
  }
}
